#include <PCM.h>
// uncomment for log to debug
const int led = 13; //board led at pin 13
const int inbutt = A3; //signal pin from esp8266
const int relay = A0; //signal pin to relay at A0
const int feedback = A1; //led for status feedback and speaker
const int tank = A5; //signal pin from tank
int s = 0;
int ts = 0;
int i, j;
int count = 0;
int lcount = 0;
int countj = 0;
//music in 16 bit for 3s converted
const unsigned char sample[] PROGMEM = {
  126, 127, 128, 128, 128, 129, 128, 127, 127, 127, 128, 128,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 124,
};
void setup() {
  // put your setup code here, to run once:
  //Serial.begin(9600);
  pinMode(led, OUTPUT); ///red->led output
  pinMode(inbutt, INPUT); ///esp on signal input ---> uno
  pinMode(relay, OUTPUT); ///blue light output
  pinMode(tank, INPUT); ///tank-->uno

  pinMode(feedback, OUTPUT); ///uno-->esp
  digitalWrite(feedback, LOW);

}

void loop() {
  ts = 0;
  // put your main code here, to run repeatedly:
  s = digitalRead(inbutt);
  //Serial.println("WiFi On Signal Received");
  if (s == HIGH)

  { //Serial.println("LED on");
    //Serial.print("<---");
    digitalWrite(led, HIGH);
    delay(180);

    //////
    ts = 0;
    ts = digitalRead(tank);

    if (ts == HIGH) {
      for (i = 0; i < 50; i++)
      { delay(15);
        if (digitalRead(tank) == HIGH)
        { ++count;
          delay(60);
        }
        delay(15);
        if (digitalRead(tank) == LOW)
        { ++lcount;
          delay(60);
          //Serial.println("\n>>>>>>>>>>>>>>>>>");
          //Serial.println(lcount);
          //Serial.println("\n>>>>>>>>>>>>>>>>>");
        }
        delay(15);
        if (lcount >= 1)
        { i = 40;
          //Serial.println("*******Fake Signal detection*********");
          count = 60;
          digitalWrite(feedback, LOW);
          break;
        }
        //Serial.println("==>");
        //Serial.print(i);
      }

      if (count > 49 && lcount < 1)
      {
        //Serial.println("-------Sound and Light---------");
        digitalWrite(feedback, HIGH);
        delay(10);
        digitalWrite(relay, HIGH);
        delay(300);
        startPlayback(sample, sizeof(sample));

        digitalWrite(relay, LOW);
        ts = 0;
        delay(10);

      }

      else {
        digitalWrite(relay, LOW);
        //Serial.println("System OFF");
        digitalWrite(feedback, LOW);
      }
    }
    /////////////

  }
  if (digitalRead(tank) == LOW)
  {
    digitalWrite(feedback, LOW);
  }
  digitalWrite(led, LOW);

  delay(200);

  count = 0;
  lcount = 0;

}

